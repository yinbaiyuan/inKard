#include "main.h"
#include "stdio.h"
#include "epaper.h" 
#include "TriangleProtocol.h"
#include "system_init.h"

#define EEPROM_BASE_ADDR	0x08080000	
#define EEPROM_BYTE_SIZE	0x07FF
#define FLASH_BASE_ADDR		0x08000000
#define FLASH_USER_OFFSET	(100*0x80)

#define PEKEY1	0x89ABCDEF		//FLASH_PEKEYR
#define PEKEY2	0x02030405		//FLASH_PEKEYR
#define EN_INT      	__enable_irq();		//系统开全局中断
#define DIS_INT     	__disable_irq();	//系统关全局中断

UART_HandleTypeDef huart1;
uint8_t UART1_Rx_rec = 0;       						//USART1接收数据缓存

void EEPROM_ReadBytes(uint16_t Addr,uint8_t *Buffer,uint16_t Length)
{
	uint8_t *wAddr;
	wAddr=(uint8_t *)(EEPROM_BASE_ADDR+Addr);
	while(Length--){
		*Buffer++=*wAddr++;
	}	
}

void Flash_ReadBytes(uint32_t Addr,uint8_t *Buffer,uint16_t Length)
{
	uint8_t *wAddr;
	wAddr=(uint8_t *)(FLASH_BASE_ADDR+FLASH_USER_OFFSET+Addr);
	while(Length--){
		*Buffer++=*wAddr++;
	}
}


void EEPROM_WriteBytes(uint16_t Addr,uint8_t *Buffer,uint16_t Length)
{
	uint8_t *wAddr;
	wAddr=(uint8_t *)(EEPROM_BASE_ADDR+Addr);
	DIS_INT
	FLASH->PEKEYR=PEKEY1;				//unlock
	FLASH->PEKEYR=PEKEY2;
	while(FLASH->PECR&FLASH_PECR_PELOCK);
	while(Length--){
		*wAddr++=*Buffer++;
		while(FLASH->SR&FLASH_SR_BSY);
	}
	FLASH->PECR|=FLASH_PECR_PELOCK;
	EN_INT
}


void Flash_WriteBytes(uint32_t pages,uint8_t *Buffer,uint16_t Length)
{
  //1、解锁FLASH
  HAL_FLASH_Unlock();
	//2、擦除FLASH
  //初始化FLASH_EraseInitTypeDef
  FLASH_EraseInitTypeDef f;
  f.TypeErase = FLASH_TYPEERASE_PAGES;
  f.PageAddress = FLASH_BASE_ADDR + FLASH_USER_OFFSET + pages * 0x80;
  f.NbPages = Length / 128 + 1;
	
  uint32_t PageError = 0;
  HAL_FLASHEx_Erase(&f, &PageError);
	uint32_t wAddr;
	wAddr=(uint32_t)(FLASH_BASE_ADDR + FLASH_USER_OFFSET + pages * 0x80);
	while(Length>0){
		uint32_t temp = (*(Buffer+3))<<24 | (*(Buffer+2))<<16 | (*(Buffer+1))<<8 | (*Buffer)<<0 ;
		HAL_FLASH_Program(FLASH_TYPEPROGRAM_WORD , wAddr, temp);
		wAddr+=4;
		Length-=4;
		Buffer+=4;
	}
	
  //4、锁住FLASH
  HAL_FLASH_Lock();
}





#define PROTOCOL_CALLBACK(x) void pId_callback_##x(byte *payload, unsigned int length, bool isTimeout)

#define PROTOCOL_REGISTER(x)                                      \
  {                                                               \
    if (isTimeout || payload[0] == 255) 													\
    {                                                             \
      pId_callback_##x(payload + 1, length - 1, isTimeout);       \
    }                                                             \
  }                                                               \
  break

unsigned char imgBuffer[5000] = { /* 0X01,0X01,0XC8,0X00,0XC8,0X00, */
0xFF,0xFF,0xFF,0xFF,0xFF,0xFF,0xFF,0xFF,0xFF,0xFF,0xFF,0xFF,0xFF,0xFF,0xFF,0xFF,
0xFF,0xFF,0xFF,0xFF,0xFF,0xFF,0xFF,0xFF,0xFF,0xFF,0xFF,0xFF,0xFF,0xFF,0xFF,0xFF,
0xFF,0xFF,0xFF,0xFF,0xFF,0xFF,0xFF,0xFF,0xFF,0xFF,0xFF,0xFF,0xFF,0xFF,0xFF,0xFF,
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0xFF,0xFF,0xFF,0xFF,0xFF,0xFF,0xFF,0xFF};

unsigned char imgEnableBuffer[9] = {0};

int pagesOfArea = 40;

int c_areaId = 0;

void writeImageDataToFlash(int areaId,uint8_t *buffer,uint16_t length)
{
	Flash_WriteBytes(pagesOfArea*(areaId - 1),buffer,length);
}

void readImageDataFromFlash(int areaId,uint8_t *buffer,uint16_t length)
{
	Flash_ReadBytes(pagesOfArea * (areaId - 1) * 0x80,buffer,length);
	c_areaId = areaId;
}

PROTOCOL_CALLBACK(10)
{
	TPT.tpBegin(10,255).tpTransmit();
}

PROTOCOL_CALLBACK(100)
{
	uint8_t areaId = payload[0];
	uint16_t begin = uint16_t(payload[1] << 8) + uint16_t(payload[2]);
	uint16_t blength = uint16_t(payload[3] << 8) + uint16_t(payload[4]);
	for(int i = begin;i<begin+blength;i++)
	{
		imgBuffer[i] = payload[i-begin+5];
	}
	TPT.tpBegin(100, 255).tpByte(areaId).tpUint16(begin).tpUint16(blength).tpTransmit();
}

PROTOCOL_CALLBACK(101)
{
	uint8_t areaId = payload[0];
	writeImageDataToFlash(areaId,imgBuffer,5000);
	TPT.tpBegin(101, 255).tpByte(areaId).tpTransmit();
}

PROTOCOL_CALLBACK(102)
{
	for(int i = 0;i<9;i++)
	{
		imgEnableBuffer[i] = payload[i];
	}
	EEPROM_WriteBytes(0,imgEnableBuffer,9);
	TPT.tpBegin(102,255).tpTransmit();
}

PROTOCOL_CALLBACK(103)
{
	uint8_t areaId = payload[0];
	readImageDataFromFlash(areaId,imgBuffer,5000);
	EPD_HW_Init(); //Electronic paper initialization
	EPD_WhiteScreen_ALL((const unsigned char*)imgBuffer); //Refresh the picture in full screen
	TPT.tpBegin(103,255).tpTransmit();
}

PROTOCOL_CALLBACK(200)
{
	TPT.tpBegin(200,255);
  for(int i = 0;i<9;i++)
  {
		TPT.tpByte(imgEnableBuffer[i]);
  }
  TPT.tpTransmit();
}

PROTOCOL_CALLBACK(201)
{
	uint8_t areaId = payload[0];
	if(c_areaId != areaId)
	{
		readImageDataFromFlash(areaId,imgBuffer,5000);
	}
	uint16_t begin = uint16_t(payload[1] << 8) + uint16_t(payload[2]);
	uint16_t blength = uint16_t(payload[3] << 8) + uint16_t(payload[4]);
	TPT.tpBegin(201, 255).tpByte(areaId).tpUint16(begin).tpUint16(blength).tpBuffer(imgBuffer+begin,blength).tpTransmit();
}

void tpCallback(byte pId, byte *payload, unsigned int length, bool isTimeout)
{

	switch (pId)
  {
		case 10:
      PROTOCOL_REGISTER(10);
		case 100:
      PROTOCOL_REGISTER(100);
    case 101:
      PROTOCOL_REGISTER(101);
		case 102:
      PROTOCOL_REGISTER(102);
		case 103:
      PROTOCOL_REGISTER(103);
    case 200:
			PROTOCOL_REGISTER(200);
		case 201:
			PROTOCOL_REGISTER(201);
  }
}

void transmitCallback(byte *ptBuffer, unsigned int ptLength)
{
	HAL_UART_Transmit_IT(&huart1,ptBuffer,ptLength);
}


void HAL_UART_RxCpltCallback(UART_HandleTypeDef *huart)
{
	if(huart->Instance==USART1)
  {
		TPT.tpPushData(UART1_Rx_rec).tpParse();
		HAL_UART_Receive_IT(&huart1,&UART1_Rx_rec, 1);
  }
}


int main(void)
{
  HAL_Init();
  SystemClock_Config();
  MX_GPIO_Init();
  MX_USART1_UART_Init();
	HAL_UART_Receive_IT(&huart1,&UART1_Rx_rec, 1);
	TPT.callbackRegister(tpCallback, transmitCallback);
	
	HAL_GPIO_WritePin(GPIOA, GPIO_PIN_2, GPIO_PIN_SET);
	
	EEPROM_ReadBytes(0,imgEnableBuffer,9);
	for(int i = 0 ; i < 8 ; i++)
	{
		uint8_t pointer = (imgEnableBuffer[0] + i) % 8 + 1;
		if(imgEnableBuffer[pointer] != 0)
		{
			imgEnableBuffer[0] = pointer;
			break;
		}
	}
	EEPROM_WriteBytes(0,imgEnableBuffer,9);
	HAL_UART_Transmit_IT(&huart1,imgEnableBuffer,9);
	if(imgEnableBuffer[0] != 0)
	{
		readImageDataFromFlash(imgEnableBuffer[0],imgBuffer,5000);
	}
	EPD_HW_Init(); //Electronic paper initialization
	EPD_WhiteScreen_ALL((const unsigned char*)imgBuffer); //Ref
	//EPD_WhiteScreen_White();
	HAL_GPIO_WritePin(GPIOA, GPIO_PIN_2, GPIO_PIN_RESET);
	//TODO：点亮LED
	
	
	
  while (1)
  {

  }

}


void Error_Handler(void)
{

}

